OUTPUT_FORMAT("elf64-littleaarch64")
OUTPUT_ARCH(aarch64)
ENTRY(_start)

USER_LOAD_BASE = @USER_LOAD_BASE@;

SECTIONS {
    . = USER_LOAD_BASE;

    .text : {
        KEEP(*(.text.entry))
        *(.text*)
    }

    . = ALIGN(4096);
    .rodata : ALIGN(4096) { *(.rodata*) }

    . = ALIGN(4096);
    .data : ALIGN(4096) { *(.data*) }

    .bss : ALIGN(4096) {
        __bss_start = .;
        *(.bss*)
        *(COMMON)
        . = ALIGN(4096);
        __bss_end = .;
    }

    /DISCARD/ : {
        *(.comment)
        *(.eh_frame*)
        *(.note*)
        *(.gnu*)
    }
}
